#include "SPI.H"

#define LCD_COMMAND  0 
#define LCD_DATA     1

#define LCD_WIDTH   84 // Note: x-coordinates go wide
#define LCD_HEIGHT  48 // Note: y-coordinates go high
#define WHITE       0  // For drawing pixels. A 0 draws white.
#define BLACK       1  // A 1 draws black.

char displayMap[LCD_WIDTH * LCD_HEIGHT / 8] = {
  0x00, 0x00, 0x00, 0x00, 0x00, 0x00, 0x00, 0x00, 0x00, 0x00, 0x00, 0x00, // (0,0)->(11,7) ~ These 12 bytes cover an 8x12 block in the left corner of the display 
  0x00, 0x00, 0x00, 0x00, 0x00, 0x00, 0x00, 0x00, 0x00, 0x00, 0x00, 0x00, // (12,0)->(23,7)
  0x00, 0x00, 0x00, 0x00, 0x00, 0x00, 0x00, 0x00, 0x00, 0x00, 0x00, 0xE0, // (24,0)->(35,7)
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  0x00, 0x00, 0x00, 0x00, 0x00, 0x00, 0x00, 0x00, 0x00, 0x00, 0x00, 0x00, // (72,40)->(83,47) !!! The bottom right pixel!
};


void LCD5110_GPIO_Config()
{
	GPIO_InitTypeDef GPIOA_Init;
	GPIO_InitTypeDef GPIOC_Init;
	RCC_AHB1PeriphClockCmd(RCC_AHB1Periph_GPIOA|RCC_AHB1Periph_GPIOC, ENABLE);
	GPIOA_Init.GPIO_Pin = GPIO_Pin_8;
	GPIOA_Init.GPIO_Speed = GPIO_Speed_25MHz;
	GPIOA_Init.GPIO_Mode = GPIO_Mode_OUT;
	GPIOA_Init.GPIO_PuPd = GPIO_PuPd_NOPULL;
	GPIOA_Init.GPIO_OType = GPIO_OType_PP;
	GPIOC_Init.GPIO_Pin = GPIO_Pin_6|GPIO_Pin_7|GPIO_Pin_8|GPIO_Pin_9;
	GPIOC_Init.GPIO_Speed = GPIO_Speed_25MHz;
	GPIOC_Init.GPIO_PuPd = GPIO_PuPd_NOPULL;
	GPIOC_Init.GPIO_Mode = GPIO_Mode_OUT;
	GPIOC_Init.GPIO_OType = GPIO_OType_PP;
	GPIO_Init(GPIOA,&GPIOA_Init);
	GPIO_Init(GPIOC,&GPIOC_Init);
}

void LCD5110_CS(unsigned char OnOff)
{
if (OnOff)
 	GPIO_SetBits(GPIOC, GPIO_Pin_9);
else 
GPIO_ResetBits(GPIOC, GPIO_Pin_9);
}

void LCD5110_SCK(unsigned char OnOff)
{
if (OnOff)
 	GPIO_SetBits(GPIOA, GPIO_Pin_8);
else 
GPIO_ResetBits(GPIOA, GPIO_Pin_8);
}



void LCD5110_RST(unsigned char OnOff)
{
if (OnOff)
 	GPIO_SetBits(GPIOC, GPIO_Pin_7);
else 
GPIO_ResetBits(GPIOC, GPIO_Pin_7);
}

void LCD5110_DC(unsigned char OnOff)
{
if (OnOff)
 	GPIO_SetBits(GPIOC, GPIO_Pin_8);
else 
GPIO_ResetBits(GPIOC, GPIO_Pin_8);
}

void LCD5110_MO(unsigned char OnOff)
{
if (OnOff)
 	GPIO_SetBits(GPIOC, GPIO_Pin_6);
else 
GPIO_ResetBits(GPIOC, GPIO_Pin_6);
}






void LCDWrite(unsigned char mode, unsigned char data)
{
	unsigned char i;

	LCD5110_CS(0); /* SPI_CS = 0, вибір веденого пристрою*/
	if (!mode) /* mode визначає, що передається: команда чи дані */
		LCD5110_DC(0); /* LCD_DC = 0; */
	else
		LCD5110_DC(1); /* LCD_DC = 1; */

	for(i = 0; i < 8; i++)
	{
		LCD5110_MO(data & 0x80); //SPI_MO = dat & 0x80;
		data = data<<1;
		LCD5110_SCK(0);//SPI_SCK = 0;
		LCD5110_SCK(1);//SPI_SCK = 1;
	}
	LCD5110_CS(1); //SPI_CS = 1;
}


//Робота з дисплеєм починається, звісно ж, з ініціалізації. Приклад функції ініціалізації:

void LCD_init()
{ 
	LCD5110_GPIO_Config();

	LCD5110_DC(1);
	LCD5110_MO(1);
	LCD5110_SCK(1);
	LCD5110_CS(1);
	
	LCD5110_RST(0);
	osDelay(10);
	LCD5110_RST(1);

	LCDWrite(0, 0x21);
	LCDWrite(0, 0xc6);
	LCDWrite(0, 0x06);
	LCDWrite(0, 0x13);
	LCDWrite(0, 0x20);
	LCDWrite(0, 0x0c);
}  


void gotoXY(unsigned char X,unsigned char Y)
{
	unsigned char x;
	x = 6*X;
	LCDWrite(0x40|Y,0);
	LCDWrite(0x80|x,0);
}

void updateDisplay()
{
	int i;
  gotoXY(0, 0);
  for (i=0; i < (LCD_WIDTH * LCD_HEIGHT / 8); i++)
  {
    LCDWrite(LCD_DATA, displayMap[i]);
  }
}

void setPixel(int x, int y, char bw)
{
  if ((x >= 0) && (x < LCD_WIDTH) && (y >= 0) && (y < LCD_HEIGHT))
  {
    char shift = y % 8;
  
    if (bw)
      displayMap[x + (y/8)*LCD_WIDTH] |= 1<<shift;
    else
      displayMap[x + (y/8)*LCD_WIDTH] &= ~(1<<shift);
  }
}

void clearDisplay(int bw)
{
	int i;
  for (i=0; i<(LCD_WIDTH * LCD_HEIGHT / 8); i++)
  {
    if (bw)
      displayMap[i] = 0xFF;
    else
      displayMap[i] = 0;
  }
}

























